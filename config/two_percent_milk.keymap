#include <behaviors.dtsi>
#include <dt-bindings/zmk/keys.h>
#include <dt-bindings/zmk/bt.h>

/ {
    keymap {
        compatible = "zmk,keymap";

        // Default Layer: Physical Left Key = Clear, Physical Right Key = Select Profile 0
        default_layer {
            bindings = <
                &bt BT_CLR    &bt BT_SEL 0
            >;
        };
    };
};
